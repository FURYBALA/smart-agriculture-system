/*
  Vision Node — ESP32-CAM + TensorFlow Lite Micro
  --------------------------------------------------
  On-device tomato leaf disease classification (8 classes — see
  class_labels.h). Captures a 96x96 frame every kCaptureIntervalMs,
  runs INT8 inference locally, and:
    1. prints the result to Serial (as in the project report), and
    2. exposes it over a small REST endpoint so the Flutter app can
       poll the latest on-device result as a free, offline-capable
       alternative to cloud (Gemini Vision) diagnosis.

  Note on scope vs. the original report: the report's ESP32-CAM
  module could not be integrated with the mobile app because live
  MJPEG video streaming to the app was unreliable on this hardware.
  This firmware sidesteps that specific problem rather than solving
  it: it does NOT stream video. It only exposes the latest
  classification result as a small JSON payload over HTTP, which is
  a much lighter integration than a live video feed and doesn't hit
  the same streaming/bandwidth limitation.

  model_data.h and class_labels.h are generated by
  ml/scripts/convert_tflite.py — do not hand-edit them; retrain and
  reconvert instead.

  Board: ESP32-CAM (AI-Thinker), PSRAM enabled.

  Required libraries (Arduino Library Manager):
    - A TensorFlow Lite for Microcontrollers port for ESP32
      (e.g. "TensorFlowLite_ESP32" or "Chirale_TensorFlowLite")
    - esp32 board package (provides esp_camera.h)

  NOT hardware-tested: written against the standard TFLite Micro
  C++ API and reviewed carefully, but this environment had no ESP32
  toolchain or physical board to compile/flash against. See
  docs/bring-up-checklist.md before your first flash.
*/

#include <WiFi.h>
#include <WebServer.h>
#include "esp_camera.h"
#include "esp_heap_caps.h"
#include "camera_pins.h"
#include "config.h"
#include "model_data.h"
#include "class_labels.h"
#include "vision_logic.h"

#include <tensorflow/lite/micro/micro_interpreter.h>
#include <tensorflow/lite/micro/micro_mutable_op_resolver.h>
#include <tensorflow/lite/micro/micro_log.h>
#include <tensorflow/lite/micro/system_setup.h>
#include <tensorflow/lite/schema/schema_generated.h>

WebServer server(kHttpServerPort);
unsigned long lastCaptureAt = 0;

// ---- Latest result, served over /latest ----
String latestClass = "unknown";
float latestConfidence = 0.0f;
unsigned long latestAtMillis = 0;

// ---- TFLite Micro globals ----
// The arena lives in PSRAM, not internal DRAM: a static/global array
// this size (250 KB) plus WiFi/WebServer's own static buffers doesn't
// fit in the ESP32's ~320 KB of internal DRAM -- confirmed by CI,
// which caught a ~186 KB link-time DRAM overflow with this as a plain
// static array. PSRAM is slower per-access than internal SRAM, but
// for inference every few seconds that's a non-issue.
uint8_t* tensor_arena = nullptr;
const tflite::Model* model = nullptr;
tflite::MicroInterpreter* interpreter = nullptr;
TfLiteTensor* modelInput = nullptr;
TfLiteTensor* modelOutput = nullptr;

// Ops used by the trained model: Conv2D, MaxPool2D, Mean (global avg
// pool), FullyConnected, Softmax.
tflite::MicroMutableOpResolver<5> resolver;

bool setupModel() {
  tensor_arena = static_cast<uint8_t*>(
      heap_caps_malloc(kTensorArenaSize, MALLOC_CAP_SPIRAM | MALLOC_CAP_8BIT));
  if (tensor_arena == nullptr) {
    Serial.println("Failed to allocate tensor arena in PSRAM -- is PSRAM enabled in board settings?");
    return false;
  }

  model = tflite::GetModel(g_tomato_disease_model);
  if (model->version() != TFLITE_SCHEMA_VERSION) {
    MicroPrintf("Model schema version mismatch: model=%d supported=%d",
                model->version(), TFLITE_SCHEMA_VERSION);
    return false;
  }

  resolver.AddConv2D();
  resolver.AddMaxPool2D();
  resolver.AddMean();
  resolver.AddFullyConnected();
  resolver.AddSoftmax();

  static tflite::MicroInterpreter static_interpreter(
      model, resolver, tensor_arena, kTensorArenaSize);
  interpreter = &static_interpreter;

  if (interpreter->AllocateTensors() != kTfLiteOk) {
    MicroPrintf("AllocateTensors() failed -- increase kTensorArenaSize");
    return false;
  }

  modelInput = interpreter->input(0);
  modelOutput = interpreter->output(0);
  return true;
}

bool setupCamera() {
  camera_config_t config;
  config.ledc_channel = LEDC_CHANNEL_0;
  config.ledc_timer = LEDC_TIMER_0;
  config.pin_d0 = Y2_GPIO_NUM;
  config.pin_d1 = Y3_GPIO_NUM;
  config.pin_d2 = Y4_GPIO_NUM;
  config.pin_d3 = Y5_GPIO_NUM;
  config.pin_d4 = Y6_GPIO_NUM;
  config.pin_d5 = Y7_GPIO_NUM;
  config.pin_d6 = Y8_GPIO_NUM;
  config.pin_d7 = Y9_GPIO_NUM;
  config.pin_xclk = XCLK_GPIO_NUM;
  config.pin_pclk = PCLK_GPIO_NUM;
  config.pin_vsync = VSYNC_GPIO_NUM;
  config.pin_href = HREF_GPIO_NUM;
  config.pin_sccb_sda = SIOD_GPIO_NUM;
  config.pin_sccb_scl = SIOC_GPIO_NUM;
  config.pin_pwdn = PWDN_GPIO_NUM;
  config.pin_reset = RESET_GPIO_NUM;
  config.xclk_freq_hz = 20000000;
  config.pixel_format = PIXFORMAT_RGB565;
  config.frame_size = FRAMESIZE_96X96;
  config.fb_location = CAMERA_FB_IN_PSRAM;
  config.fb_count = 1;
  config.grab_mode = CAMERA_GRAB_WHEN_EMPTY;

  return esp_camera_init(&config) == ESP_OK;
}

void preprocessFrame(camera_fb_t* fb) {
  // esp32-camera's RGB565 output is big-endian per pixel (high byte
  // first), not the Xtensa core's native little-endian -- reading it
  // through a uint16_t* cast byte-swaps every pixel. Combine the two
  // bytes explicitly instead. The actual unpack/normalize/quantize math
  // lives in vision_logic.h so it can be host-tested (see
  // firmware/test/test_vision_logic.cpp) without a camera or a TFLite
  // Micro build.
  const uint8_t* bytes = fb->buf;
  const int pixelCount = kInputWidth * kInputHeight;

  for (int i = 0; i < pixelCount; i++) {
    vision_logic::RgbNormalized rgb =
        vision_logic::decodeRgb565BigEndian(bytes[i * 2], bytes[i * 2 + 1]);

    modelInput->data.int8[i * 3 + 0] = vision_logic::quantizeChannel(rgb.r, kInputScale, kInputZeroPoint);
    modelInput->data.int8[i * 3 + 1] = vision_logic::quantizeChannel(rgb.g, kInputScale, kInputZeroPoint);
    modelInput->data.int8[i * 3 + 2] = vision_logic::quantizeChannel(rgb.b, kInputScale, kInputZeroPoint);
  }
}

void runInference() {
  camera_fb_t* fb = esp_camera_fb_get();
  if (!fb) {
    Serial.println("Camera capture failed");
    return;
  }

  preprocessFrame(fb);
  esp_camera_fb_return(fb);

  if (interpreter->Invoke() != kTfLiteOk) {
    Serial.println("Inference failed");
    return;
  }

  const float outScale = modelOutput->params.scale;
  const int outZeroPoint = modelOutput->params.zero_point;

  vision_logic::Prediction pred = vision_logic::argmaxDequantized(
      modelOutput->data.int8, kNumClasses, outScale, outZeroPoint);

  latestClass = kClassLabels[pred.classIndex];
  latestConfidence = pred.confidence;
  latestAtMillis = millis();

  Serial.printf("Prediction: %s  (%.1f%% confidence)\n", latestClass.c_str(), latestConfidence * 100.0f);
}

// ---- REST: GET /latest -> { class, confidence, ageMs, hasResult } ----
void handleLatest() {
  // latestAtMillis == 0 means no inference has ever succeeded yet
  // (right after boot, or every attempt so far has failed). That's
  // not "age 0" (freshest possible) -- it's "no result exists" --
  // hasResult makes that explicit instead of relying on callers to
  // infer it from age, which a caller checking only "is age > 60s"
  // would get backwards (0 looks freshest, not oldest).
  bool hasResult = latestAtMillis != 0;
  unsigned long age = hasResult ? (millis() - latestAtMillis) : 0;
  String json = "{";
  json += "\"class\":\"" + latestClass + "\",";
  json += "\"confidence\":" + String(latestConfidence, 3) + ",";
  json += "\"hasResult\":" + String(hasResult ? "true" : "false") + ",";
  json += "\"ageMs\":" + String(age);
  json += "}";
  server.send(200, "application/json", json);
}

void connectWiFi() {
  WiFi.mode(WIFI_STA);
  WiFi.begin(WIFI_SSID, WIFI_PASSWORD);
  Serial.print("Connecting to Wi-Fi");
  while (WiFi.status() != WL_CONNECTED) {
    delay(300);
    Serial.print(".");
  }
  Serial.println();
  Serial.print("Connected. IP address: ");
  Serial.println(WiFi.localIP());
  Serial.println("^ point the Flutter app's ESP32-CAM host setting at this IP.");
}

void setup() {
  Serial.begin(115200);
  delay(300);
  Serial.println("\nVision Node -- booting");

  tflite::InitializeTarget();

  if (!setupModel()) {
    Serial.println("Model setup failed -- halting");
    while (true) delay(1000);
  }
  Serial.println("Model loaded.");

  if (!setupCamera()) {
    Serial.println("Camera setup failed -- halting");
    while (true) delay(1000);
  }
  Serial.println("Camera ready.");

  connectWiFi();
  server.on("/latest", HTTP_GET, handleLatest);
  server.begin();

  Serial.println("System online. Point the camera at a leaf.\n");
}

void loop() {
  server.handleClient();

  if (millis() - lastCaptureAt >= kCaptureIntervalMs) {
    lastCaptureAt = millis();
    runInference();
  }
}
